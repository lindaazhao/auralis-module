## boards/shields/auralis/Kconfig.defconfig
```kconfig
if SHIELD_AURALIS_RIGHT

config ZMK_KEYBOARD_NAME
    default "Auralis"

config ZMK_SPLIT_ROLE_CENTRAL
    default y

endif

if SHIELD_AURALIS_LEFT || SHIELD_AURALIS_RIGHT

config ZMK_SPLIT
    default y

endif
```

## boards/shields/auralis/Kconfig.shield
```kconfig
config SHIELD_AURALIS_LEFT
    def_bool $(shields_list_contains,auralis_left)
    
config SHIELD_AURALIS_RIGHT
    def_bool $(shields_list_contains,auralis_right)
```
